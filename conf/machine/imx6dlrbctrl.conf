## conf/machine/imx6dlrbctrl.conf
```bitbake
#@TYPE: Machine
#@NAME: Freescale i.MX6DL SABRE Smart Device
#@SOC: i.MX6DL
#@DESCRIPTION: Machine configuration for Freescale i.MX6DL SABRE Smart Device
#@MAINTAINER: Otavio Salvador <otavio@ossystems.com.br>

require conf/machine/include/imx6sabresd-common.inc

SOC_FAMILY = "mx6:mx6dl"

#KERNEL_DEVICETREE = "imx6dl-rbctrl-800x600.dtb imx6dl-rbctrl.dtb imx6dl-rbctrl-1024x600.dtb"


KERNEL_DEVICETREE = "imx6dl-rbctrl-1024x600.dtb imx6dl-rbctrl-800x600.dtb imx6dl-rbctrl.dtb "

#MACHINE_FEATURES_BACKFILL_CONSIDERED += "rtc"

UBOOT_CONFIG ??= "nand"
UBOOT_CONFIG[sd] = "mx6dlsabreauto_config,sdcard"
UBOOT_CONFIG[eimnor] = "mx6dlsabreauto_eimnor_config"
UBOOT_CONFIG[nand] = "mx6dlsabreauto_nand_config,ubifs"
UBOOT_CONFIG[spinor] = "mx6dlsabreauto_spinor_config"
UBOOT_CONFIG[mfgtool] = "mx6dlsabreauto_config"


SERIAL_CONSOLE = "115200 ttymxc1"
KERNEL_IMAGETYPE = "uImage"

KERNEL_MODULE_AUTOLOAD += " fec smsc911x rbt_fpga ntfs "

MACHINE_ESSENTIAL_EXTRA_RRECOMMENDS += " \
	kernel-module-fec \
	kernel-module-smsc911x \
	kernel-module-hid \
	kernel-module-hid-generic \
	kernel-module-nls-cp936 \
	kernel-module-nls-utf8 \
	kernel-module-ntfs \
	kernel-module-rbt-fpga \
"


MACHINE_FIRMWARE_append_mx6dl = "firmware-imx-sdma-imx6q"
```

## conf/machine/include/imx6dlrbctrl.inc
```bitbake
# Provides the i.MX6 SABRE SD common settings

require conf/machine/include/imx-base.inc
require conf/machine/include/tune-cortexa9.inc

SERIAL_CONSOLE = "115200 ttymxc0"



KERNEL_MODULE_AUTOLOAD += "fec smsc" 

MACHINE_ESSENTIAL_EXTRA_RRECOMMENDS += " \
	kernel-module-fec \
	kernel-module-smsc \
	kernel-module-hid \
	kernel-module-usbhid \
	kernel-module-hid-genreic \
	kernel-module-nls-cp936 \
	kernel-module-nls-utf8 \ "
```
